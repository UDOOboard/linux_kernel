/*
 * Copyright 2013 Freescale Semiconductor, Inc.
 * Copyright 2015 Aidilab, Srl.
 *
 * Author: Fabio Estevam <fabio.estevam@freescale.com>
 * Author: Ettore Chimenti <ettore.chimenti@udoo.org>
 *
 * This program is free software; you can redistribute it and/or modify
 * it under the terms of the GNU General Public License version 2 as
 * published by the Free Software Foundation.
 *
 */

/dts-v1/;

#include "imx6dl.dtsi"
#include "imx6qdl-seco_A62.dtsi"

/ {
	model = "SECO i.MX6 DualLite SBC (A62) Board";
	compatible = "fsl,imx6dl-SBC_A62", "fsl,imx6dl";

	mxcfb1: fb@0 {
		compatible = "fsl,mxc_sdc_fb";
		disp_dev = "hdmi";
		interface_pix_fmt = "RGB24";
		mode_str ="1920x1080M@60";
		default_bpp = <32>;
		int_clk = <0>;
		late_init = <0>;
		status = "okay";
	};
};

&mxcfb2 {
	status = "disabled";
};

