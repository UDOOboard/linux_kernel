/*
 * Copyright (C) 2015 Jasbir Matharu
 * Author: Ettore Chimenti <ek5.chimenti@gmail.com>
 *
 * This program is free software; you can redistribute it and/or modify
 * it under the terms of the GNU General Public License version 2 as
 * published by the Free Software Foundation.
 */


/ {
	model = "UDOO Neo Full";
};
