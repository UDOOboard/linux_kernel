/*
* Author: Ettore Chimenti <ek5.chimenti@gmail.com>
*
* This program is free software; you can redistribute it and/or modify
* it under the terms of the GNU General Public License version 2 as
* published by the Free Software Foundation.
*
* This dts is been autogenerated by scripts/make-udoo-dtbs
*
*/

/dts-v1/;

#include "imx6sx-udoo-neo.dtsi" 
#include "imx6sx-udoo-neo-basic.dtsi"
#include "imx6sx-udoo-neo-m4.dtsi"
#include "imx6sx-udoo-neo-lvds7.dtsi"
