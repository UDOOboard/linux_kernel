## backports/Kconfig
```kconfig
config BACKPORT_INTEGRATE
	bool
	def_bool y

config BACKPORT_DIR
	string
	default "backports/"

config BACKPORT_VERSION
	string
	default "v4.1.1-1-0-g8286954"

config BACKPORT_KERNEL_VERSION
	string
	default "v4.1.7-0-g0c5c1f1"

config BACKPORT_KERNEL_NAME
	string
	default "Linux"

menuconfig BACKPORT_LINUX
	bool "Backport Linux v4.1.7-0-g0c5c1f1 (backports v4.1.1-1-0-g8286954)"
	default n
	---help---
	  Enabling this will let give you the opportunity to use features and
	  drivers backported from Linux v4.1.7-0-g0c5c1f1
	  on the kernel your are using. This is experimental and you should
	  say no unless you'd like to help test things or want to help debug
	  this should we run into any issues.

if BACKPORT_LINUX

source "$BACKPORT_DIR/Kconfig.versions"
source "$BACKPORT_DIR/Kconfig.sources"

endif # BACKPORT_LINUX
```

## backports/drivers/media/platform/xilinx/Kconfig
```kconfig
config BACKPORT_VIDEO_XILINX
	tristate "Xilinx Video IP (EXPERIMENTAL)"
	depends on !VIDEO_XILINX
	depends on VIDEO_V4L2 && BACKPORT_VIDEO_V4L2_SUBDEV_API && OF
	select BACKPORT_VIDEOBUF2_DMA_CONTIG
	---help---
	  Driver for Xilinx Video IP Pipelines

if BACKPORT_VIDEO_XILINX

config BACKPORT_VIDEO_XILINX_TPG
	tristate "Xilinx Video Test Pattern Generator"
	depends on !VIDEO_XILINX_TPG
	depends on BACKPORT_VIDEO_XILINX
	select BACKPORT_VIDEO_XILINX_VTC
	---help---
	   Driver for the Xilinx Video Test Pattern Generator

config BACKPORT_VIDEO_XILINX_VTC
	tristate "Xilinx Video Timing Controller"
	depends on !VIDEO_XILINX_VTC
	depends on BACKPORT_VIDEO_XILINX
	---help---
	   Driver for the Xilinx Video Timing Controller

endif #VIDEO_XILINX
```

## drivers/misc/udooneo/Kconfig
```kconfig
config FXOS8700_ACC_MAG_I2C
tristate "FXOS8700 - 6-Axis Acc and Mag Combo Sensor driver" 
depends on ARM
default y if ARM
help
  Freescale FXOS8700 - Digital Sensor - 3D Accelerometer (±2g/±4g/±8g) + 3D Magnetometer.

config FXAS2100X_GYRO_I2C
tristate "FXAS21002C - Freescale 3-Axis Digital Gyroscope driver" 
depends on ARM
default y if ARM
help
  Freescale FXAS21002C - Freescale 3-Axis Digital Gyroscope driver.
```

## drivers/seco/Kconfig
```kconfig
#
#  SECO system driver
#

menu "SECO mxc support"

config ECTRL
	bool "Communication system with the Embedded Controller"
	depends on I2C && ARCH_MXC 
	help
		Say Y here if you wanto to use the SecoCommunication System with the Embedded Controller.
		
		if usure, say Y.

endmenu
```
